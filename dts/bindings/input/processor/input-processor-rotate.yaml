## dts/bindings/input/processor/input-processor-rotate.yaml
```yaml
description: |
  ZMK input processor that rotates relative X/Y movement by a fixed angle.
  Used to compensate for the tilted trackpad on Toucan2.

  Positive degrees compensate for a trackpad that is rotated counter-clockwise
  (its top edge rises to the right). Use a negative value for the opposite tilt.

  X and Y arrive as separate events (X without sync, then Y with sync), so the
  rotated Y is emitted immediately and the rotated X is carried over to the next
  X event. Total movement is preserved; X lags by one report.

  Example:
    zip_rotate: zip_rotate {
        compatible = "zmk,input-processor-rotate";
        #input-processor-cells = <0>;
        rotation-degrees = <20>;
    };

compatible: "zmk,input-processor-rotate"

properties:
  rotation-degrees:
    type: int
    required: true
    description: Rotation angle in degrees (-90 to 90).
  track-remainders:
    type: boolean
    description: Unused (remainders are always tracked internally); required by zmk,input-listener.
  carry-timeout-ms:
    type: int
    default: 100
    description: Drop a carried-over X value older than this (e.g. after lifting the finger).
```

## dts/bindings/input/processor/input-processor-scroll-axis-lock.yaml
```yaml
description: |
  ZMK input processor that locks scrolling to one axis per gesture.
  Place it after the XY-to-scroll mapper and before the scroll scaler.

  HWHEEL and WHEEL arrive as separate events (HWHEEL without sync, then WHEEL with sync).
  Once enough movement has accumulated, the dominant axis is locked until scrolling stops
  for release-ms; the other axis is dropped.

  Example:
    zip_scroll_axis_lock: zip_scroll_axis_lock {
        compatible = "zmk,input-processor-scroll-axis-lock";
        #input-processor-cells = <0>;
    };

compatible: "zmk,input-processor-scroll-axis-lock"

properties:
  threshold:
    type: int
    default: 8
    description: Movement (before scaling) needed to pick the axis at the start of a gesture.
  release-ms:
    type: int
    default: 300
    description: Unlock the axis after this long without scroll movement.
  track-remainders:
    type: boolean
    description: Unused; required by zmk,input-listener.
```
